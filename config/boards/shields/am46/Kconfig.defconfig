## config/boards/shields/am46/Kconfig.defconfig
```kconfig
# Copyright (c) 2021 Ross Harmes
# SPDX-License-Identifier: MIT

if SHIELD_AM46

config ZMK_KEYBOARD_NAME
    default "AM46"

endif
```

## config/boards/shields/am46/Kconfig.shield
```kconfig
# Copyright (c) 2021 Ross Harmes
# SPDX-License-Identifier: MIT

config SHIELD_AM46
    def_bool $(shields_list_contains,am46)
```
